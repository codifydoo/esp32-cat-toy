## main/Kconfig.projbuild
```kconfig
menu "Cat toy"
    config CAT_DEV_DIAG
        bool "Boot into the hardware diagnostic screen"
        default n
    config CAT_DEV_GALLERY
        bool "Boot into the cat gallery (every state and costume)"
        default n
    config CAT_DEV_SOAK
        bool "Run the app open/close soak test after boot"
        default n
    config CAT_DEV_POWER_DIAG
        bool "Boot into the power diagnostics (gauge, touch INT, PWR pin, deep-sleep wakes)"
        default n
    config CAT_DEV_IGNORE_USB
        bool "Treat USB power as battery (deep sleep and the battery screens on the Mac's cable)"
        default n
    config CAT_DEV_BATTERY_DRAIN
        bool "Fake a draining battery: 12 % at boot, one point less every 10 s; 1 % after a battery sleep"
        default n
    config CAT_DEV_FAST_SLEEP
        bool "Deep-sleep 20 s after the panel goes off instead of 10 minutes"
        default n
    config CAT_DEV_AUTO_WAKE
        bool "Wake 10 s into every deep sleep as a touch would, the panel off 15 s after start (wake cycles without hands)"
        depends on CAT_DEV_FAST_SLEEP
        default n
    config CAT_HOME_ON_POWER
        bool "Use PWR as Home (only if BOOT cannot be pressed through the case)"
        default n
        help
            Spec 3.6: a short PWR press becomes Home, and a double press turns the screen off/on.
    config CAT_WIFI_SSID
        string "Wi-Fi network for setting the clock (NTP)"
        default ""
        help
            Spec 3.2 and 8. Set this and CAT_WIFI_PASSWORD only in the git-ignored sdkconfig.secrets
            (README, "Wi-Fi for the clock"), never in a committed file. Empty: no NTP, and the parent
            sets the clock by hand.
    config CAT_WIFI_PASSWORD
        string "Wi-Fi password"
        default ""
endmenu
```
